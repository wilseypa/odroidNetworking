## linux/drivers/hardkernel/Kconfig
```kconfig
menu "Hardkernel Specific Hardware"

config ODROID_U2_FAN
	bool "Enable the PWM Controlled FAN on ODROID-U2"
	depends on ODROID_U2
	default y
	---help---
		Enables the PWM Controlled FAN on ODROID-U2


config VIDEO_SAMSUNG_S5P_HDMI_CEC
        tristate "Enable CEC support for HDMI Driver"
        default n
        help
          Enables CEC over the HDMI driver.
          CEC enables tv-control, and reception of tv-remote
          control commands over the HDMI interface


endmenu
```

## ofa_kernel-1.5.2/drivers/infiniband/hw/rxe/Kconfig
```kconfig
config INFINIBAND_RXE
	tristate "Soft IBXoE Driver"
	depends on 64BIT && NET
	---help---
	This is a driver for a soft implementation of IBXoE/RXoE.
```
